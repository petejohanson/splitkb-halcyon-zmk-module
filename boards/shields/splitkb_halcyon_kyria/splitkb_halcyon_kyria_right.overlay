/*
 * Copyright (c) 2023 The ZMK Contributors
 *
 * SPDX-License-Identifier: MIT
 */

#include "splitkb_halcyon_kyria.dtsi"

&default_transform {
    col-offset = <7>;
};

/*
&right_encoder {
    status = "okay";
};
*/
