## boards/shields/splitkb_halcyon_display_mod/Kconfig.defconfig
```kconfig
if SHIELD_SPLITKB_HALCYON_DISPLAY_MOD

config LV_Z_MEM_POOL_SIZE
	default 8192

config MAIN_STACK_SIZE
	default 8192

config SYSTEM_WORKQUEUE_STACK_SIZE
	default 8192

config ZMK_DISPLAY_BLANK_ON_IDLE
	default y

endif
```

## boards/splitkb/splitkb_halcyon_controller/Kconfig.splitkb_halcyon_controller
```kconfig
# Copyright (c) 2021 Pete Johanson
# SPDX-License-Identifier: Apache-2.0

config BOARD_SPLITKB_HALCYON_CONTROLLER
	select SOC_RP2040
```

## boards/splitkb/splitkb_halcyon_controller/board.yml
```yaml
board:
  name: splitkb_halcyon_controller
  vendor: splitkb
  socs:
    - name: rp2040
```
