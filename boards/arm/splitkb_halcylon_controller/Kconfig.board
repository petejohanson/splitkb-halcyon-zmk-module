## boards/arm/splitkb_halcylon_controller/Kconfig.board
```kconfig
# Copyright (c) 2021 Pete Johanson
# SPDX-License-Identifier: Apache-2.0

config BOARD_SPLITKB_HALCYON_CONTROLLER
	bool "splitkb.com Halcyon Controller"
	depends on SOC_RP2040
```

## boards/arm/splitkb_halcylon_controller/Kconfig.defconfig
```kconfig
# Copyright (c) 2021 Pete Johanson
# SPDX-License-Identifier: Apache-2.0

if BOARD_SPLITKB_HALCYON_CONTROLLER

config BOARD
	default "splitkb_halcyon_controller"

config RP2_FLASH_W25Q080
	default y

endif # BOARD_SPLITKB_HALCYON_CONTROLLER
```

## boards/shields/splitkb_halcyon_display_mod/Kconfig.shield
```kconfig
# Copyright (c) 2020 Pete Johanson
# SPDX-License-Identifier: MIT

config SHIELD_SPLITKB_HALCYON_DISPLAY_MOD
    def_bool $(shields_list_contains,splitkb_halcyon_display_mod)
    imply ZMK_DISPLAY
    imply LV_THEME_DEFAULT_DARK
    imply LV_USE_THEME_DEFAULT
    select GPIO_HOGS
```

## boards/shields/splitkb_halcyon_kyria/Kconfig.defconfig
```kconfig
if SHIELD_SPLITKB_HALCYON_KYRIA_LEFT

config ZMK_KEYBOARD_NAME
    default "Kyria"

config ZMK_SPLIT_ROLE_CENTRAL
    default y

endif

if SHIELD_SPLITKB_HALCYON_KYRIA_RIGHT

config ZMK_KEYBOARD_NAME
    default "Kyria Right"

endif

if SHIELD_SPLITKB_HALCYON_KYRIA

config ZMK_SPLIT
    default y

endif
```

## boards/shields/splitkb_halcyon_kyria/Kconfig.shield
```kconfig
# Copyright (c) 2020 Pete Johanson
# SPDX-License-Identifier: MIT

config SHIELD_SPLITKB_HALCYON_KYRIA
    bool

config SHIELD_SPLITKB_HALCYON_KYRIA_LEFT
    def_bool $(shields_list_contains,splitkb_halcyon_kyria_left)
    select SHIELD_SPLITKB_HALCYON_KYRIA

config SHIELD_SPLITKB_HALCYON_KYRIA_RIGHT
    def_bool $(shields_list_contains,splitkb_halcyon_kyria_right)
    select SHIELD_SPLITKB_HALCYON_KYRIA
```
